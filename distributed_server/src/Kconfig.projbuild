## distributed_server/src/Kconfig.projbuild
```kconfig
menu "Configuração do Wifi"

    config ESP_WIFI_SSID
        string "WiFi SSID"
        default "ssid"
        help
            Nome da rede Wifi.

    config ESP_WIFI_PASSWORD
        string "Senha do Wifi"
        default "minha_senha"
        help
            Senha do WiFi (WPA or WPA2).

    config ESP_MAXIMUM_RETRY
        int "Número máximo de tentativas de conexão"
        default 5
        help
            Configure o valor máximo de tentativas de conexão.
endmenu

menu "Configuração Servidor Central"
    config ESP_MQTT_URI
        string "Uri"
        default "mqtt://0.0.0.0"
        help
            Endereço IP do ThingsBoard

    config ESP_MQTT_USERNAME
        string "Username"
        default "token_de_acesso"
        help
            Token de acesso do dispositivo no ThingsBoard
endmenu
```
